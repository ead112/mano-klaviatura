/ {
    chosen {
        zmk,kscan = &kscan0;
    };

    kscan0: kscan_0 {
        compatible = "zmk,kscan-gpio-matrix";
        label = "KSCAN";
        diode-direction = "col2row";

        row-gpios
            = <&gpio0 6  (GPIO_ACTIVE_HIGH | GPIO_PULL_DOWN)> // Row 0 (Pin 1)
            , <&gpio0 9  (GPIO_ACTIVE_HIGH | GPIO_PULL_DOWN)> // Row 1 (Pin 13)
            , <&gpio0 10 (GPIO_ACTIVE_HIGH | GPIO_PULL_DOWN)> // Row 2 (Pin 14)
            , <&gpio1 11 (GPIO_ACTIVE_HIGH | GPIO_PULL_DOWN)> // Row 3 (Pin 15)
            , <&gpio1 13 (GPIO_ACTIVE_HIGH | GPIO_PULL_DOWN)> // Row 4 (Pin 16)
            ;

        col-gpios
            = <&gpio0 8  GPIO_ACTIVE_HIGH> // Col 0  (Pin 2)
            , <&gpio0 17 GPIO_ACTIVE_HIGH> // Col 1  (Pin 5)
            , <&gpio0 20 GPIO_ACTIVE_HIGH> // Col 2  (Pin 6)
            , <&gpio0 22 GPIO_ACTIVE_HIGH> // Col 3  (Pin 7)
            , <&gpio0 24 GPIO_ACTIVE_HIGH> // Col 4  (Pin 8)
            , <&gpio1 0  GPIO_ACTIVE_HIGH> // Col 5  (Pin 9)
            , <&gpio0 11 GPIO_ACTIVE_HIGH> // Col 6  (Pin 10)
            , <&gpio1 4  GPIO_ACTIVE_HIGH> // Col 7  (Pin 11)
            , <&gpio1 6  GPIO_ACTIVE_HIGH> // Col 8  (Pin 12)
            , <&gpio1 15 GPIO_ACTIVE_HIGH> // Col 9  (Pin 17)
            , <&gpio0 2  GPIO_ACTIVE_HIGH> // Col 10 (Pin 18)
            , <&gpio0 29 GPIO_ACTIVE_HIGH> // Col 11 (Pin 19)
            ;
    };
};
